## config/boards/arm/muri_m92/Kconfig.board
```kconfig
# Copyright (c) 2021 Kuba Birecki
# SPDX-License-Identifier: MIT

config BOARD_MURI_M92
	bool "muri_one_board"
	depends on SOC_NRF52840_QIAA
```

## config/boards/arm/muri_m92/Kconfig.defconfig
```kconfig
# Copyright (c) 2021 Kuba Birecki
# SPDX-License-Identifier: MIT

# Muri One keyboard configuration

if BOARD_MURI_M92

config ZMK_KEYBOARD_NAME
	default "Muri ONE"

if USB_DEVICE_STACK

config USB_NRFX
	default y

endif # USB_DEVICE_STACK

config BT_CTLR
	default BT

config ZMK_BLE
	default y

config ZMK_KSCAN_MATRIX_POLLING
	default y

config ZMK_SLEEP
	default y

config ZMK_USB
	default y

endif # BOARD_MURI_M92
```

## config/boards/arm/muri_one/Kconfig.board
```kconfig
# Copyright (c) 2021 Kuba Birecki
# SPDX-License-Identifier: MIT

config BOARD_MURI_ONE
	bool "muri_one_board"
	depends on SOC_NRF52840_QIAA
```

## config/boards/arm/muri_one/muri_one_defconfig
```kconfig
# Copyright (c) 2021 Kuba Birecki
# SPDX-License-Identifier: MIT

# Board definition
CONFIG_SOC_SERIES_NRF52X=y
CONFIG_SOC_NRF52840_QIAA=y
CONFIG_BOARD_MURI_ONE=y

# Enable MPU
CONFIG_ARM_MPU=y

# Enable FPU
CONFIG_FPU=y

# Enable code partitions
CONFIG_USE_DT_CODE_PARTITION=y

# Enable flash
CONFIG_MPU_ALLOW_FLASH_WRITE=y
CONFIG_NVS=y
CONFIG_SETTINGS_NVS=y
CONFIG_FLASH=y
CONFIG_FLASH_PAGE_LAYOUT=y
CONFIG_FLASH_MAP=y

# Enable Library
CONFIG_NEWLIB_LIBC=y

# Enable I2C
CONFIG_I2C=y
CONFIG_I2C_0=y

# Enable GPIO
CONFIG_GPIO=y

# Enable reset pin
CONFIG_GPIO_AS_PINRESET=y

# Enable USB
CONFIG_USB=y

# Enable IS31Fl3741 driver
CONFIG_IS31FL3741=y

# Enable CY8CMBR3106s driver
CONFIG_CY8CMBR3106S=y

# ZMK Features
CONFIG_ZMK_ANIMATION=y
CONFIG_ZMK_SETTINGS_SAVE_DEBOUNCE=15000
CONFIG_ZMK_SLEEP=y
CONFIG_ZMK_TOUCH_SLIDER=y
CONFIG_ZMK_HID_CONSUMER_REPORT_USAGES_BASIC=y

# Enable logging
CONFIG_ZMK_USB_LOGGING=y
CONFIG_LOG=y
CONFIG_PRINTK=y
CONFIG_CONSOLE=y
```

## config/boards/arm/onigiri/Kconfig.board
```kconfig
# Copyright (c) 2024 Kuba Birecki
# SPDX-License-Identifier: MIT

config BOARD_ONIGIRI
	bool "onigiri_board"
	depends on SOC_NRF52840_QIAA
```

## config/boards/arm/onigiri/Kconfig.defconfig
```kconfig
# Copyright (c) 2024 Kuba Birecki
# SPDX-License-Identifier: MIT

# Onigiri keyboard configuration

if BOARD_ONIGIRI

config ZMK_KEYBOARD_NAME
	default "Onigiri KB"

if USB

config USB_NRFX
	default y

config USB_DEVICE_STACK
	default y

endif # USB

config BT_CTLR
	default BT

config ZMK_BLE
	default y

config ZMK_KSCAN_MATRIX_POLLING
	default y

config ZMK_SLEEP
	default y

config ZMK_USB
	default y

endif # BOARD_ONIGIRI
```

## config/boards/arm/onigiri/onigiri_defconfig
```kconfig
# Copyright (c) 2024 Kuba Birecki
# SPDX-License-Identifier: MIT

# Board definition
CONFIG_SOC_SERIES_NRF52X=y
CONFIG_SOC_NRF52840_QIAA=y
CONFIG_BOARD_ONIGIRI=y

# Enable MPU
CONFIG_ARM_MPU=y

# Enable FPU
CONFIG_FPU=y

# Enable code partitions
CONFIG_USE_DT_CODE_PARTITION=y

# Enable flash
CONFIG_MPU_ALLOW_FLASH_WRITE=y
CONFIG_NVS=y
CONFIG_SETTINGS_NVS=y
CONFIG_FLASH=y
CONFIG_FLASH_PAGE_LAYOUT=y
CONFIG_FLASH_MAP=y

# Enable Library
CONFIG_NEWLIB_LIBC=y

# Enable I2C
CONFIG_I2C=y
CONFIG_I2C_NRFX=y

# Enable GPIO
CONFIG_GPIO=y

# Enable reset pin
CONFIG_GPIO_AS_PINRESET=y

# Enable IS31Fl3743A driver
CONFIG_LED_STRIP=y
CONFIG_LED_STRIP_IS31FL3743A=y

# ZMK Features
CONFIG_ZMK_BLE=y
# CONFIG_ZMK_SLEEP=y
CONFIG_ZMK_USB=y
CONFIG_ZMK_RGB_FX=y

CONFIG_BUILD_OUTPUT_UF2=y

CONFIG_NEWLIB_LIBC_FLOAT_PRINTF=y
```

## config/west.yml
```yaml
manifest:
  remotes:
    - name: zmkfirmware
      url-base: https://github.com/zmkfirmware
    - name: crystalplanet
      url-base: https://github.com/crystalplanet
  projects:
    - name: zmk
      remote: zmkfirmware
      revision: main
      import: app/west.yml
    - name: zephyr-issi-drivers
      remote: crystalplanet
      revision: main
    - name: zmk-rgb-fx
      remote: crystalplanet
      revision: main
  self:
    path: config
```
